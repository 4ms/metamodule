SYS.CPU STM32MP153D-CM4
SYS.Mode Attach

PRIVATE &builddir
&builddir=OS.PPF()
&builddir=OS.FILE.PATH("&builddir")

PRIVATE &elffile
&elffile=OS.FILE.JOINPATH("&builddir", "../", "build", "mp1corem4", "medium", "main_m4.elf")
&elffile=OS.FILE.REALPATH("&elffile")

Data.LOAD.Elf "&elffile" /CPP /NoCode

;Break
