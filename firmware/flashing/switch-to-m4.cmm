SYS.CPU STM32MP153D-CM4
SYS.Mode Attach
Data.LOAD.Elf /Users/dann/4ms/stm32/meta-module/firmware/build/mp1corem4/medium/main_m4.elf /CPP /NOCODE
Break