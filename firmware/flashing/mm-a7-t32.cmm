; Load a multi-uimg file to DDR RAM, and then trigger MP1-Boot to process it
; This assumes this script is in flashing/, and the uimg file is build/main.uimg
; and the elf file (used for symbols) is build/mp1corea7/medium/main.elf

PRIVATE &builddir
&builddir=OS.PPF()
&builddir=OS.FILE.PATH("&builddir")

PRIVATE &binfile
&binfile=OS.FILE.JOINPATH("&builddir", "../", "build", "main.uimg")
&binfile=OS.FILE.REALPATH("&binfile")

PRIVATE &elffile
&elffile=OS.FILE.JOINPATH("&builddir", "../", "build", "mp1corea7", "medium", "main.elf")
&elffile=OS.FILE.REALPATH("&elffile")

RESet
SYStem.RESet

SYStem.CPU STM32MP153D-CA7
SYStem.JtagClock 50MHz
CORE.ASSIGN 1. 2.

Trace.DISable
SYStem.MemAccess DAP
SYStem.Up

Data.LOAD.Binary "&binfile" 0xC0000000
Data.LOAD.Elf "&elffile" /CPP /NoCode
PER.Set.simple AZSD:0x0:0x5C00A118 %Long 0xC0000000
;Break main
Go

Trace.METHOD ONCHIP
ETM.Trace ON
ETM.ON

ENDDO

// CHECK THE ADDRESS THAT PLUGIN IS LOADED TO (e.g. 0xd001e800)
// data.load.elf /Users/dann/4ms/stm32/meta-module/firmware/vcv_ports/build/Befaco.so 0xd001e800 /cpp /nocode
// data.load.elf /Users/dann/4ms/stm32/meta-module/firmware/build/mp1corea7/medium/main.elf /cpp /nocode